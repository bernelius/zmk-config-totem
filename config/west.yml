## config/west.yml
```yaml
# manifest:
  # remotes:
    # - name: zmkfirmware
      # url-base: https://github.com/zmkfirmware
    # # Additional modules containing boards/shields/custom code can be listed here as well
    # # See https://docs.zephyrproject.org/3.2.0/develop/west/manifest.html#projects
  # projects:
    # - name: zmk
      # remote: zmkfirmware
      # revision: main
      # import: app/west.yml
  # self:
    # path: config


manifest:
  remotes:
    - name: zmkfirmware
      url-base: https://github.com/zmkfirmware
    - name: urob
      url-base: https://github.com/urob
  projects:
    - name: zmk
      remote: zmkfirmware
      revision: v0.3.0
      import: app/west.yml
    # Apply patch to fix child nodes issue
    - name: zephyr
      remote: urob
      revision: v3.5.0+zmk-fixes
      clone-depth: 1
      import:
        name-allowlist: [lvgl]
  self:
    path: config
```
